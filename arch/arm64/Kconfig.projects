## arch/arm64/Kconfig.projects
```kconfig
config SEC_A52Q_PROJECT
	depends on ARCH_ATOLL
	default n
	bool "Samsung A52Q Project"
	help
	  Support for Samsung A52Q Project

config SEC_A52Q_EUR_OPEN
	depends on SEC_A52Q_PROJECT 
	default n
	bool "Samsung A52Q EUR OPEN"
	help
	  Support for Samsung A52Q EUR OPEN device.

config SEC_GTA4XLVE_PROJECT
	default n
	bool "Samsung GTA4XLVE Project"
	help
	  Support for Samsung GTA4XLVE Project

config SEC_GTA4XLVE_EUR_OPEN
	default n
	bool "Samsung GTA4XLVE EUR OPEN"
	help
	  Support for Samsung GTA4XLVE EUR OPEN device.
```
